## boards/u-blox/railnet200_nina_b301/railnet200_nina_b301/Kconfig.railnet200_nina_b301
```kconfig
# Railnet200 NINA-B301 board configuration
# Copyright (c) 2025 Naonext
# SPDX-License-Identifier: Apache-2.0

config BOARD_RAILNET200_NINA_B301
	select SOC_NRF52840_QIAA
```

## boards/u-blox/railnet200_nina_b301/railnet200_nina_b301/board.yml
```yaml
board:
  name: railnet200_nina_b301
  full_name: Naonext Railnet200 NINA-B301
  vendor: u-blox
  socs:
  - name: nrf52840
```

## samples/bluetooth/hci_uart/boards/railnet200_nina_b301_nrf52840.conf
```kconfig
CONFIG_CONSOLE=y
CONFIG_UART_CONSOLE=n
CONFIG_USE_SEGGER_RTT=y
CONFIG_RTT_CONSOLE=y
CONFIG_LOG=y
CONFIG_LOG_BACKEND_RTT=y
CONFIG_LOG_BACKEND_UART=n
CONFIG_BT_CTLR_ADVANCED_FEATURES=y
```
