## CMakeLists.txt
```
# samples/bluetooth/peripheral_ots_railnet/CMakeLists.txt
#
# Firmware Zephyr OTS (Object Transfer Service) pour NINA-B301 / nRF52840
# sur la carte RailNet200.
#
# Ce firmware remplace hci_uart : le NINA-B301 n'est plus un contrôleur HCI
# mais un périphérique BLE autonome exposant un serveur GATT OTS (UUID 0x1825).
#
# Architecture :
#   Android (OTS Central) <-- BLE L2CAP CoC --> NINA-B301 <-- UART SOTP --> iMX6
#
# Voir docs/ble-obex-bredr-investigation.md pour le contexte complet.

cmake_minimum_required(VERSION 3.20.0)
find_package(Zephyr REQUIRED HINTS $ENV{ZEPHYR_BASE})
project(peripheral_ots_railnet)

target_sources(app PRIVATE
    src/main.c
    src/ots_handler.c
    src/uart_relay.c
    src/config_service.c
)
```

## prj.conf
```kconfig
# samples/bluetooth/peripheral_ots_railnet/prj.conf
#
# Configuration Kconfig commune à tous les boards.
# Les overrides board-specific sont dans boards/railnet200_nina_b301_nrf52840.conf.
#
# --- Bluetooth ---
CONFIG_BT=y
CONFIG_BT_PERIPHERAL=y
# Nom affiché lors du scan BLE depuis Android
CONFIG_BT_DEVICE_NAME="RailNet200"

# --- OTS : Object Transfer Service (UUID 0x1825) ---
# Service GATT standardisé, remplaçant BLE d'OBEX.
CONFIG_BT_OTS=y
# Objet directory listing obligatoire selon la spec OTS
CONFIG_BT_OTS_DIR_LIST_OBJ=y
# Nombre maximum d'objets simultanément stockés en RAM
# 4 = 1 dir listing + 3 chunks de données (fichier 64KB découpé en 3 × 30KB)
# RAM : 4 × 32KB = 128KB pool objets + stack BLE ≈ 80% RAM nRF52840
CONFIG_BT_OTS_MAX_OBJ_CNT=4
# Support de l'écriture du nom d'objet (requis par BT_OTS_OACP_CREATE_SUPPORT)
CONFIG_BT_OTS_OBJ_NAME_WRITE_SUPPORT=y
# Support des opérations OACP (Object Action Control Point)
CONFIG_BT_OTS_OACP_WRITE_SUPPORT=y
CONFIG_BT_OTS_OACP_PATCH_SUPPORT=y
CONFIG_BT_OTS_OACP_CREATE_SUPPORT=y
CONFIG_BT_OTS_OACP_DELETE_SUPPORT=y
CONFIG_BT_OTS_OACP_CHECKSUM_SUPPORT=y
# Support de la navigation dans la liste d'objets (OLCP)
CONFIG_BT_OTS_OLCP_GO_TO_SUPPORT=y

# --- UART (relay vers iMX6) ---
CONFIG_SERIAL=y
CONFIG_UART_INTERRUPT_DRIVEN=y

# --- Logs ---
# Les logs sont envoyés via RTT (SEGGER) — voir board conf
CONFIG_LOG=y
CONFIG_ASSERT=y
# Debug L2CAP et OTS pour diagnostiquer le rejet de connexion CoC
CONFIG_BT_L2CAP_LOG_LEVEL_DBG=y
CONFIG_BT_OTS_LOG_LEVEL_DBG=y

# --- L2CAP CoC (requis par OTS pour le transfert de données) ---
CONFIG_BT_L2CAP_DYNAMIC_CHANNEL=y

# --- Stack sizes ---
# OTS utilise une stack BT_RX plus grande (traitement L2CAP CoC)
CONFIG_BT_RX_STACK_SIZE=2048

# --- L2CAP SEG_RECV (réception segment par segment, sans buffer complet SDU) ---
# Avec SEG_RECV, Zephyr appelle seg_recv() pour chaque PDU reçu au lieu de
# reassembler le SDU complet en RAM. Cela permet d'annoncer un rx.mtu grand
# (= taille max objet) sans allouer un buffer de cette taille.
# bt_l2cap_chan_give_credits() est aussi disponible uniquement avec SEG_RECV.
CONFIG_BT_L2CAP_SEG_RECV=y

# --- DLE (Data Length Extension) nRF52840 ---
# nRF52840 supporte DLE jusqu'à 251 bytes de payload LL.
# rx.mps est fixé dans ots_l2cap.c à 245 = DLE_max(251) - L2CAP_HDR(4) - SDU_LEN(2).
# PDU complet (1er PDU du SDU) = 4+2+245 = 251 bytes = 1 LL PDU DLE → pas de fragment.
# Zephyr (l2cap.c:1263) écrase rx.mps si rx.mps > BT_L2CAP_RX_MTU = ACL_RX_SIZE-4.
# ACL_RX_SIZE=255 → BT_L2CAP_RX_MTU=251 ≥ 245 → clamp ne s'applique pas → OK.
# Buffer ACL = 1+4+255 = 260 bytes → tailroom=4 après START(251) → sécurité si CONT.
# rx.mtu = taille max SDU = 32768 (champ déclaratif, pas de buffer de cette taille).
CONFIG_BT_CTLR_DATA_LENGTH_MAX=251
CONFIG_BT_BUF_ACL_RX_SIZE=255
CONFIG_BT_OTS_L2CAP_CHAN_RX_MTU=32768
# Buffers extra pour crédits initiaux (8 crédits = 8 PDUs simultanés acceptés).
CONFIG_BT_BUF_ACL_RX_COUNT_EXTRA=8
# Permet à l'application d'initier DLE via bt_conn_le_data_len_update().
# Nécessaire car le contrôleur nRF52840 Zephyr ne négocie pas DLE automatiquement
# (BT_HCI_QUIRKS=0 → bt_drv_quirk_no_auto_dle()=false → auto-update jamais déclenché).
# Sans DLE : PDUs LL = 27 bytes → un PDU L2CAP CoC de 251 bytes = 10 fragments
# → overflow buffer ACL RX (255 bytes) au 10ème fragment.
CONFIG_BT_USER_DATA_LEN_UPDATE=y
```

## boards/railnet200_nina_b301_nrf52840.conf
```kconfig
# samples/bluetooth/peripheral_ots_railnet/boards/railnet200_nina_b301_nrf52840.conf
#
# Configuration spécifique au board railnet200_nina_b301 (nRF52840).
# Ce fichier est appliqué EN PLUS de prj.conf quand on compile pour ce board.
#
# RailNet200 hardware notes :
#   - UART0 : connecté à l'iMX6 (/dev/ttymxc7), hw-flow-control RTS/CTS validé
#   - Pinctrl : CTS=P0.31 (ball55 iMX6), RTS=P1.12 (ball58 iMX6)
#   - Debug : SEGGER JLink SWD, RTT pour les logs
#   - BD Address statique souhaitée : DE:CA:F1:5B:AD:00

# Désactiver la console UART (uart0 est utilisé pour SOTP, pas pour les logs)
CONFIG_CONSOLE=y
CONFIG_UART_CONSOLE=n

# Activer RTT pour les logs de debug
CONFIG_USE_SEGGER_RTT=y
CONFIG_RTT_CONSOLE=y
CONFIG_LOG_BACKEND_RTT=y
CONFIG_LOG_BACKEND_UART=n

# Fonctionnalités avancées du contrôleur BLE Nordic
CONFIG_BT_CTLR_ADVANCED_FEATURES=y

# Augmenter le buffer RTT pour éviter les "messages dropped" pendant uart_relay
# (le relay UART poll_out est bloquant et noie le buffer RTT par défaut de 512 octets)
CONFIG_SEGGER_RTT_BUFFER_SIZE_UP=4096
CONFIG_LOG_BUFFER_SIZE=4096
```

## boards/railnet200_nina_b301_nrf52840.overlay
```dts
/*
 * railnet200_nina_b301_nrf52840.overlay
 *
 * Overlay DTS pour le sample peripheral_ots_railnet.
 * Appliqué EN PLUS du DTS de base du board par le système de build west/cmake.
 *
 * Objectif :
 *   Déclarer `zephyr,sotp-uart = &uart0` dans /chosen pour que uart_relay.c
 *   puisse obtenir le device UART via DT_CHOSEN(zephyr_sotp_uart) plutôt
 *   que DT_CHOSEN(zephyr_bt_c2h_uart) qui appartient sémantiquement à hci_uart.
 *
 * Pourquoi non-destructif :
 *   Le DTS de base (railnet200_nina_b301_nrf52840.dts) conserve
 *   `zephyr,bt-c2h-uart = &uart0`. Ce chosen n'est utilisé que quand
 *   CONFIG_BT_HCI_RAW=y (firmware hci_uart). Ce firmware utilise
 *   CONFIG_BT_HCI_HOST, donc le chosen bt-c2h-uart est ignoré ici.
 *   Les deux firmwares peuvent coexister sans modifier le DTS partagé.
 *
 * Note baudrate :
 *   - RailNet200 v1.1 + v1.3 : RTS/CTS câblés et validés (2026-04-10)
 *     Board DTS : 115200 baud + hw-flow-control activé
 *     Pinctrl NINA corrigé : CTS=P0.31 (ball55), RTS=P1.12 (ball58)
 *     Voir docs/uart-rtscts-imx6-nina-debug.md pour l'historique complet
 *
 * Convention de nommage DT_CHOSEN :
 *   Le nom du chosen node `zephyr,sotp-uart` se mappe vers DT_CHOSEN(zephyr_sotp_uart)
 *   (Zephyr remplace les tirets par des underscores dans les macros DT_CHOSEN).
 */

/ {
	chosen {
		/*
		 * SOTP UART : l'UART utilisé par uart_relay.c pour le protocole SOTP
		 * vers l'iMX6. Même UART physique (uart0) que hci_uart, rôle différent.
		 */
		zephyr,sotp-uart = &uart0;
	};
};

/*
 * Baudrate UART vers iMX6.
 * À 115200 : une trame SOTP de 30 KB prend ~2.7s → fenêtre d'interférence USB modem.
 * À 1 Mbaud : ~0.3s → beaucoup moins de risque de corruption.
 *
 * IMPORTANT : le sotp-bridge côté iMX6 doit être compilé au même baudrate.
 * Décommenter pour 1 Mbaud quand le sotp-bridge iMX6 est aussi à 1 Mbaud.
 */
/*
 * 1 Mbaud : décommenter quand le sotp-bridge iMX6 est aussi à 1 Mbaud.
 * hw-flow-control est déjà activé dans le board DTS.
 *
 * &uart0 {
 *     current-speed = <1000000>;
 * };
 */
```

## src/main.c
```c
/*
 * peripheral_ots_railnet/src/main.c
 *
 * Firmware Zephyr OTS pour NINA-B301 (nRF52840) sur RailNet200.
 *
 * Ce firmware expose un serveur GATT OTS (Object Transfer Service, UUID 0x1825)
 * permettant à un client Android de transférer des objets (fichiers, données)
 * vers l'iMX6 via BLE, sans nécessiter de Bluetooth Classic (BR/EDR).
 *
 * Pourquoi OTS et pas OBEX ?
 *   Le nRF52840 est BLE uniquement (pas de circuit radio BR/EDR).
 *   OBEX nécessite BR/EDR → L2CAP → RFCOMM → GOEP → OBEX.
 *   OTS est le remplaçant BLE standardisé (UUID 0x1825, Bluetooth SIG 2017).
 *   Voir docs/ble-obex-bredr-investigation.md pour l'analyse complète.
 *
 * Architecture des couches :
 *   Android OTS Central
 *       ↕ BLE (GATT + L2CAP CoC)
 *   NINA-B301 : ce firmware
 *       ├── ots_handler.c : pool d'objets + callbacks OTS
 *       └── uart_relay.c  : protocole SOTP vers /dev/ttymxc7 (iMX6)
 *
 * Séquence d'initialisation :
 *   1. bt_enable(bt_ready_cb)         — démarre la stack BLE Zephyr host
 *   2. bt_ready_cb()
 *       a. ots_handler_init()         — enregistre le serveur GATT OTS
 *       b. uart_relay_init()          — initialise l'UART SOTP vers iMX6
 *       c. bt_le_adv_start()          — démarre l'advertising BLE
 *   3. Boucle principale idle
 *   4. Thread stats toutes les 10s (visible via JLinkRTTClient)
 *
 * Auteur : STIMIO / équipe développement embarqué
 * Board  : railnet200_nina_b301/nrf52840
 */

#include <zephyr/kernel.h>
#include <zephyr/bluetooth/bluetooth.h>
#include <zephyr/bluetooth/conn.h>
#include <zephyr/bluetooth/hci.h>
#include <zephyr/bluetooth/uuid.h>
#include <zephyr/bluetooth/services/ots.h>
#include <zephyr/logging/log.h>
#include <zephyr/sys/atomic.h>

#include "ots_handler.h"
#include "uart_relay.h"
#include "config_service.h"

LOG_MODULE_REGISTER(main, LOG_LEVEL_INF);

/* Work item pour différer bt_le_adv_start après disconnect.
 * Le callback disconnected() est appelé depuis le thread BT alors que
 * la stack OTS n'a pas encore libéré ses ressources internes.
 * En différant via k_work, on laisse la stack finir son cleanup avant
 * de relancer l'advertising.
 */
static struct k_work adv_restart_work;

/* -------------------------------------------------------------------------
 * Advertising data
 *
 * ad[]  = données primary advertising (envoyées dans chaque paquet ADV_IND)
 *   - Flags : General Discoverable | No BR/EDR (nRF52840 = LE only)
 *
 * sd[]  = données scan response (envoyées en réponse à un SCAN_REQ)
 *   - UUID OTS 0x1825 en 16 bits little-endian
 *   - Nom complet du device (CONFIG_BT_DEVICE_NAME = "RailNet200")
 *
 * Note : séparer UUID et Name dans sd[] permet de garder ad[] minimal
 * et de rester dans les 31 octets max par paquet.
 * ------------------------------------------------------------------------- */
static const struct bt_data ad[] = {
	BT_DATA_BYTES(BT_DATA_FLAGS,
		      BT_LE_AD_GENERAL | BT_LE_AD_NO_BREDR),
};

static const struct bt_data sd[] = {
	/* UUID OTS = 0x1825, encodé little-endian en 2 octets */
	BT_DATA_BYTES(BT_DATA_UUID16_ALL,
		      BT_UUID_16_ENCODE(BT_UUID_OTS_VAL)),
	BT_DATA(BT_DATA_NAME_COMPLETE,
		CONFIG_BT_DEVICE_NAME,
		sizeof(CONFIG_BT_DEVICE_NAME) - 1),
};

/* -------------------------------------------------------------------------
 * Statistiques atomiques
 * Lues par le thread stats (preempt 10), écrites par les callbacks BLE (BT RX).
 * Utilisation d'atomiques pour éviter les races sans mutex.
 * ------------------------------------------------------------------------- */
static atomic_t stat_ble_connections;
static atomic_t stat_objects_received;

/* -------------------------------------------------------------------------
 * Callbacks de connexion BLE
 *
 * Macro BT_CONN_CB_DEFINE enregistre les callbacks sans bt_conn_cb_register().
 * C'est l'API moderne Zephyr (évite les problèmes d'ordre d'initialisation).
 * ------------------------------------------------------------------------- */
static void connected(struct bt_conn *conn, uint8_t err)
{
	char addr[BT_ADDR_LE_STR_LEN];

	if (err) {
		LOG_ERR("Connection failed: err=%u (%s)",
			err, bt_hci_err_to_str(err));
		return;
	}

	bt_addr_le_to_str(bt_conn_get_dst(conn), addr, sizeof(addr));
	LOG_INF("Connected: %s", addr);
	atomic_inc(&stat_ble_connections);

	/* Initier DLE (Data Length Extension) : demande au peer d'utiliser des
	 * PDUs LL de 251 bytes au lieu de 27 bytes (défaut sans DLE).
	 * Sans DLE, un PDU L2CAP CoC de 251 bytes serait fragmenté en 10 LL PDUs
	 * de 27 bytes, dépassant le buffer ACL RX de 255 bytes au 10ème fragment.
	 * Le contrôleur nRF52840 Zephyr ne négocie pas DLE automatiquement,
	 * donc on l'initie explicitement ici.
	 */
	int dle_err = bt_conn_le_data_len_update(conn,
		BT_CONN_LE_DATA_LEN_PARAM(BT_GAP_DATA_LEN_MAX,
					  BT_GAP_DATA_TIME_MAX));
	if (dle_err) {
		LOG_WRN("Failed to initiate DLE: %d", dle_err);
	} else {
		LOG_INF("DLE update requested (tx_max_len=%u)", BT_GAP_DATA_LEN_MAX);
	}
}

static void adv_restart_work_handler(struct k_work *work)
{
	int err;

	ots_handler_cleanup_on_disconnect();

	err = bt_le_adv_start(BT_LE_ADV_CONN_FAST_1,
			      ad, ARRAY_SIZE(ad),
			      sd, ARRAY_SIZE(sd));
	if (err) {
		LOG_ERR("bt_le_adv_start after disconnect failed: %d", err);
	} else {
		LOG_INF("Advertising restarted");
	}
}

static void disconnected(struct bt_conn *conn, uint8_t reason)
{
	char addr[BT_ADDR_LE_STR_LEN];

	bt_addr_le_to_str(bt_conn_get_dst(conn), addr, sizeof(addr));
	LOG_INF("Disconnected: %s, reason=%u (%s)",
		addr, reason, bt_hci_err_to_str(reason));
	atomic_dec(&stat_ble_connections);

	/* Différer le restart advertising pour laisser la stack OTS
	 * finir son propre cleanup (ots_conn_disconnected) avant d'appeler
	 * bt_le_adv_start, sinon -ENOMEM car ressources pas encore libérées.
	 */
	k_work_submit(&adv_restart_work);
}

static void le_data_len_updated(struct bt_conn *conn,
				struct bt_conn_le_data_len_info *info)
{
	LOG_INF("DLE negotiated: tx_max_len=%u tx_max_time=%u "
		"rx_max_len=%u rx_max_time=%u",
		info->tx_max_len, info->tx_max_time,
		info->rx_max_len, info->rx_max_time);
}

BT_CONN_CB_DEFINE(conn_callbacks) = {
	.connected         = connected,
	.disconnected      = disconnected,
	.le_data_len_updated = le_data_len_updated,
};

/* -------------------------------------------------------------------------
 * bt_ready_cb
 *
 * Appelé par la stack Zephyr quand bt_enable() a terminé l'initialisation.
 *
 * Ordre d'appel critique :
 *   1. ots_handler_init() AVANT bt_le_adv_start()
 *      → Le service GATT OTS doit être enregistré avant qu'un central
 *        puisse se connecter et découvrir les services.
 *   2. uart_relay_init() peut être fait en parallèle (indépendant du BLE).
 * ------------------------------------------------------------------------- */
static void bt_ready_cb(int err)
{
	int ret;

	if (err) {
		LOG_ERR("bt_enable failed: %d", err);
		return;
	}

	LOG_INF("Bluetooth initialized");

	k_work_init(&adv_restart_work, adv_restart_work_handler);

	/* Initialiser le pool d'objets et le serveur GATT OTS */
	ret = ots_handler_init();
	if (ret) {
		LOG_ERR("ots_handler_init failed: %d", ret);
		return;
	}

	/* Initialiser le relay UART SOTP vers iMX6 */
	ret = uart_relay_init();
	if (ret) {
		LOG_ERR("uart_relay_init failed: %d", ret);
		return;
	}

	/* Initialiser le service GATT de configuration BLE */
	ret = config_service_init();
	if (ret) {
		LOG_ERR("config_service_init failed: %d", ret);
		return;
	}

	/*
	 * Démarrer l'advertising BLE.
	 *
	 * BT_LE_ADV_CONN_FAST_1 : connectable undirected, interval 30-60 ms.
	 * (Valeur recommandée GAP "fast interval 1" pour découverte rapide.)
	 *
	 * Note : avec hci_uart, on forçait 20ms via des commandes HCI raw.
	 * Ici on utilise directement le paramètre Zephyr host — plus propre.
	 */
	ret = bt_le_adv_start(BT_LE_ADV_CONN_FAST_1,
			      ad, ARRAY_SIZE(ad),
			      sd, ARRAY_SIZE(sd));
	if (ret) {
		LOG_ERR("bt_le_adv_start failed: %d", ret);
		return;
	}

	LOG_INF("Advertising started — name: \"%s\", UUID OTS: 0x%04X",
		CONFIG_BT_DEVICE_NAME, BT_UUID_OTS_VAL);
}

/* -------------------------------------------------------------------------
 * Thread de statistiques
 *
 * Affiche toutes les 10s via RTT (visible dans JLinkRTTClient).
 * Permet de vérifier le bon fonctionnement sans moniteur série.
 *
 * Priorité preempt(10) — moins prioritaire que le traitement BLE/UART.
 * Stack 512 octets — suffisant pour LOG_INF + atomic_get.
 * ------------------------------------------------------------------------- */
static void stats_thread_fn(void *p1, void *p2, void *p3)
{
	ARG_UNUSED(p1);
	ARG_UNUSED(p2);
	ARG_UNUSED(p3);

	while (1) {
		k_sleep(K_SECONDS(10));
		LOG_INF("Stats: BLE connections=%ld | objects received=%ld",
			(long)atomic_get(&stat_ble_connections),
			(long)atomic_get(&stat_objects_received));
	}
}

K_THREAD_DEFINE(stats_thread, 512,
		stats_thread_fn, NULL, NULL, NULL,
		K_PRIO_PREEMPT(10), 0, 0);

/* -------------------------------------------------------------------------
 * main()
 *
 * BD Address fixe : DE:CA:F1:5B:AD:11 (Random Static Address)
 *
 * bt_id_create() doit être appelé AVANT bt_enable(). Il crée une identité
 * BLE avec une adresse Random Static fixe. Les bits[47:46] doivent être 0b11
 * (obligatoire par la spec BT pour une Random Static Address).
 * DE:CA:F1:5B:AD:11 → octet de poids fort = 0xDE = 1101 1110 → bits[7:6]=11 ✓
 *
 * L'adresse est stockée en little-endian dans bt_addr_t.val :
 * index 0 = octet de poids faible (0x11), index 5 = octet de poids fort (0xDE).
 * ------------------------------------------------------------------------- */
int main(void)
{
	int err;
	bt_addr_le_t addr = {
		.type = BT_ADDR_LE_RANDOM,
		.a.val = { 0x11, 0xAD, 0x5B, 0xF1, 0xCA, 0xDE },
	};

	LOG_INF("peripheral_ots_railnet starting...");

	/* Fixer l'adresse BLE avant d'activer la stack */
	err = bt_id_create(&addr, NULL);
	if (err < 0) {
		LOG_ERR("bt_id_create failed: %d", err);
		return err;
	}
	LOG_INF("BD Address: DE:CA:F1:5B:AD:11 (Random Static)");

	/*
	 * bt_enable() est asynchrone : la stack s'initialise en tâche de fond,
	 * puis appelle bt_ready_cb() quand elle est prête.
	 * On ne bloque pas ici — la boucle while(1) ci-dessous est idle.
	 */
	err = bt_enable(bt_ready_cb);
	if (err) {
		LOG_ERR("bt_enable failed: %d", err);
		return err;
	}

	/*
	 * Boucle principale idle.
	 * Tout le traitement se fait dans :
	 *   - bt_ready_cb() et ses appels (thread système BT)
	 *   - Callbacks OTS (thread BT RX)
	 *   - Thread uart_rx (sotp_rx, défini dans uart_relay.c)
	 *   - Thread stats (défini ci-dessus)
	 */
	while (1) {
		k_sleep(K_FOREVER);
	}

	return 0;
}
```

## src/config_service.c
```c
/*
 * config_service.c
 *
 * GATT configuration service — transparent SOTP relay.
 * One characteristic per config field, all UTF-8 strings.
 */

#include "config_service.h"
#include "uart_relay.h"

#include <zephyr/kernel.h>
#include <zephyr/bluetooth/bluetooth.h>
#include <zephyr/bluetooth/gatt.h>
#include <zephyr/bluetooth/uuid.h>
#include <zephyr/logging/log.h>

#include <string.h>

LOG_MODULE_REGISTER(config_service, LOG_LEVEL_INF);

/* -------------------------------------------------------------------------
 * UUIDs — 128-bit custom STIMIO UUIDs
 *
 * Base:  5354494D-xxxx-5354-494D-535449494F44
 *        S T I M        S T   I M   S T I I O D
 *
 * Service:       xxxx = 0001
 * Control Point: xxxx = 0002
 * Status:        xxxx = 0003
 * Fields:        xxxx = 01XX (XX = field_id)
 * ------------------------------------------------------------------------- */

#define STIM_UUID_INIT(val) BT_UUID_INIT_128( \
	0x44, 0x4F, 0x49, 0x49, 0x54, 0x53, \
	0x4D, 0x49, \
	0x54, 0x53, \
	0x4D, 0x49, \
	0x54, 0x53, \
	(uint8_t)((val) & 0xFF), (uint8_t)(((val) >> 8) & 0xFF))

/* Service UUID */
static struct bt_uuid_128 svc_uuid = STIM_UUID_INIT(0x0001);

/* Control Point and Status UUIDs */
static struct bt_uuid_128 cp_uuid     = STIM_UUID_INIT(0x0002);
static struct bt_uuid_128 status_uuid = STIM_UUID_INIT(0x0003);

/* Field UUIDs: 0x0100 + field_id */
static struct bt_uuid_128 field_uuids[] = {
	STIM_UUID_INIT(0x0100), /* system.host */
	STIM_UUID_INIT(0x0101), /* system.port */
	STIM_UUID_INIT(0x0102), /* system.topic_prefix */
	STIM_UUID_INIT(0x0103), /* system.dns_primary */
	STIM_UUID_INIT(0x0104), /* system.dns_secondary */
	STIM_UUID_INIT(0x0105), /* system.enable_tls */
	STIM_UUID_INIT(0x0106), /* system.cert_reqs */
	STIM_UUID_INIT(0x0107), /* system.ca_certs */
	STIM_UUID_INIT(0x0108), /* system.certfile */
	STIM_UUID_INIT(0x0109), /* system.keyfile */
	STIM_UUID_INIT(0x010A), /* system.apn */
	STIM_UUID_INIT(0x010B), /* system.ntp_server */
	STIM_UUID_INIT(0x010C), /* system.ntp_port */
	STIM_UUID_INIT(0x010D), /* system.syslog_ip */
	STIM_UUID_INIT(0x010E), /* system.syslog_port */
	STIM_UUID_INIT(0x010F), /* system.can_bitrate */
	STIM_UUID_INIT(0x0110), /* buffer.storage_path */
	STIM_UUID_INIT(0x0111), /* buffer.max_batch_size */
};

#define CONFIG_FILE_ID   0x00   /* /etc/stimio/config.json */
#define FIELD_COUNT      18
#define MAX_VALUE_LEN    248    /* ATT_MTU(251) - 3 */
#define SOTP_TIMEOUT_MS  500

/* -------------------------------------------------------------------------
 * Shared response state (single semaphore + buffer)
 *
 * Safe because:
 * - Only one BLE connection at a time (peripheral)
 * - GATT operations are serialized by Zephyr BLE stack
 * ------------------------------------------------------------------------- */
static K_SEM_DEFINE(rsp_sem, 0, 1);

static struct {
	uint8_t  data[2 + MAX_VALUE_LEN];
	uint32_t len;
	uint8_t  type;
} rsp_buf;

/* -------------------------------------------------------------------------
 * GATT read callback — triggered for each field characteristic
 * ------------------------------------------------------------------------- */

static uint8_t field_id_from_uuid(const struct bt_uuid *uuid)
{
	const struct bt_uuid_128 *u128 = (const struct bt_uuid_128 *)uuid;
	/* Bytes 14-15 contain our value in LE */
	uint16_t val = (uint16_t)u128->val[14] | ((uint16_t)u128->val[15] << 8);
	return (uint8_t)(val - 0x0100);
}

static ssize_t field_read_cb(struct bt_conn *conn,
			     const struct bt_gatt_attr *attr,
			     void *buf, uint16_t len, uint16_t offset)
{
	uint8_t fid = field_id_from_uuid(attr->uuid);

	LOG_INF("GATT read field_id=0x%02x", fid);

	/* Send CONFIG_READ_REQ to iMX6 */
	int ret = uart_relay_send_config_read(CONFIG_FILE_ID, fid);
	if (ret) {
		LOG_ERR("field_read_cb: send failed: %d", ret);
		return BT_GATT_ERR(BT_ATT_ERR_UNLIKELY);
	}

	/* Wait for response from iMX6 */
	ret = k_sem_take(&rsp_sem, K_MSEC(SOTP_TIMEOUT_MS));
	if (ret) {
		LOG_ERR("field_read_cb: timeout waiting for iMX6 response");
		return BT_GATT_ERR(BT_ATT_ERR_UNLIKELY);
	}

	/* Check response */
	if (rsp_buf.type != SOTP_TYPE_CONFIG_READ_RSP ||
	    rsp_buf.len < 2 ||
	    rsp_buf.data[0] != CONFIG_FILE_ID ||
	    rsp_buf.data[1] != fid) {
		LOG_ERR("field_read_cb: unexpected response type=0x%02x",
			rsp_buf.type);
		return BT_GATT_ERR(BT_ATT_ERR_UNLIKELY);
	}

	/* If only 3 bytes and 3rd byte is non-zero, it's an error status */
	if (rsp_buf.len == 3 && rsp_buf.data[2] != 0) {
		LOG_WRN("field_read_cb: iMX6 returned error 0x%02x",
			rsp_buf.data[2]);
		return BT_GATT_ERR(BT_ATT_ERR_UNLIKELY);
	}

	/* Value is in rsp_buf.data[2..len-1] */
	const uint8_t *value = rsp_buf.data + 2;
	uint32_t vlen = rsp_buf.len - 2;

	return bt_gatt_attr_read(conn, attr, buf, len, offset, value, vlen);
}

/* -------------------------------------------------------------------------
 * GATT write callback — triggered for each field characteristic
 * ------------------------------------------------------------------------- */
static ssize_t field_write_cb(struct bt_conn *conn,
			      const struct bt_gatt_attr *attr,
			      const void *buf, uint16_t len,
			      uint16_t offset, uint8_t flags)
{
	uint8_t fid = field_id_from_uuid(attr->uuid);

	if (offset > 0) {
		return BT_GATT_ERR(BT_ATT_ERR_INVALID_OFFSET);
	}
	if (len > MAX_VALUE_LEN) {
		return BT_GATT_ERR(BT_ATT_ERR_INVALID_ATTRIBUTE_LEN);
	}

	LOG_INF("GATT write field_id=0x%02x len=%u", fid, len);

	/* Send CONFIG_WRITE to iMX6 */
	int ret = uart_relay_send_config_write(CONFIG_FILE_ID, fid, buf, len);
	if (ret) {
		LOG_ERR("field_write_cb: send failed: %d", ret);
		return BT_GATT_ERR(BT_ATT_ERR_UNLIKELY);
	}

	/* Wait for CONFIG_WRITE_RSP */
	ret = k_sem_take(&rsp_sem, K_MSEC(SOTP_TIMEOUT_MS));
	if (ret) {
		LOG_ERR("field_write_cb: timeout waiting for iMX6 response");
		return BT_GATT_ERR(BT_ATT_ERR_UNLIKELY);
	}

	if (rsp_buf.type != SOTP_TYPE_CONFIG_WRITE_RSP ||
	    rsp_buf.len < 3 ||
	    rsp_buf.data[2] != 0) {
		LOG_ERR("field_write_cb: error from iMX6");
		return BT_GATT_ERR(BT_ATT_ERR_UNLIKELY);
	}

	return len;
}

/* -------------------------------------------------------------------------
 * Control Point write callback — "commit" command
 * ------------------------------------------------------------------------- */

static uint8_t status_value[32];
static uint16_t status_len;

static ssize_t cp_write_cb(struct bt_conn *conn,
			   const struct bt_gatt_attr *attr,
			   const void *buf, uint16_t len,
			   uint16_t offset, uint8_t flags)
{
	if (offset > 0) {
		return BT_GATT_ERR(BT_ATT_ERR_INVALID_OFFSET);
	}

	if (len == 6 && memcmp(buf, "commit", 6) == 0) {
		LOG_INF("Control Point: commit");

		int ret = uart_relay_send_config_commit(CONFIG_FILE_ID);
		if (ret) {
			return BT_GATT_ERR(BT_ATT_ERR_UNLIKELY);
		}

		ret = k_sem_take(&rsp_sem, K_MSEC(SOTP_TIMEOUT_MS));
		if (ret) {
			LOG_ERR("cp_write_cb: timeout");
			return BT_GATT_ERR(BT_ATT_ERR_UNLIKELY);
		}

		if (rsp_buf.type == SOTP_TYPE_CONFIG_COMMIT_RSP &&
		    rsp_buf.len >= 2 && rsp_buf.data[1] == 0) {
			memcpy(status_value, "OK", 2);
			status_len = 2;
		} else {
			memcpy(status_value, "ERR", 3);
			status_len = 3;
		}

		/* Notify status — best effort.
		 * Use NULL for attrs — Zephyr searches all services. */
		bt_gatt_notify_uuid(conn, &status_uuid.uuid,
				    NULL, status_value, status_len);

		return len;
	}

	LOG_WRN("Control Point: unknown command (len=%u)", len);
	return BT_GATT_ERR(BT_ATT_ERR_NOT_SUPPORTED);
}

/* -------------------------------------------------------------------------
 * Status characteristic read callback
 * ------------------------------------------------------------------------- */
static ssize_t status_read_cb(struct bt_conn *conn,
			      const struct bt_gatt_attr *attr,
			      void *buf, uint16_t len, uint16_t offset)
{
	return bt_gatt_attr_read(conn, attr, buf, len, offset,
				 status_value, status_len);
}

/* -------------------------------------------------------------------------
 * GATT Characteristic User Description (UUID 0x2901)
 *
 * Displayed by nRF Connect and other BLE tools so the user knows
 * which JSON field each characteristic corresponds to.
 * ------------------------------------------------------------------------- */

static const char field_names[][24] = {
	[0x00] = "system.host",
	[0x01] = "system.port",
	[0x02] = "system.topic_prefix",
	[0x03] = "system.dns_primary",
	[0x04] = "system.dns_secondary",
	[0x05] = "system.enable_tls",
	[0x06] = "system.cert_reqs",
	[0x07] = "system.ca_certs",
	[0x08] = "system.certfile",
	[0x09] = "system.keyfile",
	[0x0A] = "system.apn",
	[0x0B] = "system.ntp_server",
	[0x0C] = "system.ntp_port",
	[0x0D] = "system.syslog_ip",
	[0x0E] = "system.syslog_port",
	[0x0F] = "system.can_bitrate",
	[0x10] = "buffer.storage_path",
	[0x11] = "buffer.max_batch_size",
};

static ssize_t field_desc_read_cb(struct bt_conn *conn,
				  const struct bt_gatt_attr *attr,
				  void *buf, uint16_t len, uint16_t offset)
{
	const char *desc = attr->user_data;
	return bt_gatt_attr_read(conn, attr, buf, len, offset,
				 desc, strlen(desc));
}

/* -------------------------------------------------------------------------
 * GATT Service definition
 * ------------------------------------------------------------------------- */

#define FIELD_CHAR(idx) \
	BT_GATT_CHARACTERISTIC(&field_uuids[idx].uuid, \
		BT_GATT_CHRC_READ | BT_GATT_CHRC_WRITE, \
		BT_GATT_PERM_READ | BT_GATT_PERM_WRITE, \
		field_read_cb, field_write_cb, NULL), \
	BT_GATT_DESCRIPTOR(BT_UUID_GATT_CUD, BT_GATT_PERM_READ, \
		field_desc_read_cb, NULL, (void *)field_names[idx])

BT_GATT_SERVICE_DEFINE(config_svc,
	BT_GATT_PRIMARY_SERVICE(&svc_uuid),

	/* Control Point — write only */
	BT_GATT_CHARACTERISTIC(&cp_uuid.uuid,
		BT_GATT_CHRC_WRITE,
		BT_GATT_PERM_WRITE,
		NULL, cp_write_cb, NULL),
	BT_GATT_DESCRIPTOR(BT_UUID_GATT_CUD, BT_GATT_PERM_READ,
		field_desc_read_cb, NULL, (void *)"commit"),

	/* Status — read + notify */
	BT_GATT_CHARACTERISTIC(&status_uuid.uuid,
		BT_GATT_CHRC_READ | BT_GATT_CHRC_NOTIFY,
		BT_GATT_PERM_READ,
		status_read_cb, NULL, NULL),
	BT_GATT_CCC(NULL, BT_GATT_PERM_READ | BT_GATT_PERM_WRITE),

	/* 18 field characteristics */
	FIELD_CHAR(0x00),  /* system.host */
	FIELD_CHAR(0x01),  /* system.port */
	FIELD_CHAR(0x02),  /* system.topic_prefix */
	FIELD_CHAR(0x03),  /* system.dns_primary */
	FIELD_CHAR(0x04),  /* system.dns_secondary */
	FIELD_CHAR(0x05),  /* system.enable_tls */
	FIELD_CHAR(0x06),  /* system.cert_reqs */
	FIELD_CHAR(0x07),  /* system.ca_certs */
	FIELD_CHAR(0x08),  /* system.certfile */
	FIELD_CHAR(0x09),  /* system.keyfile */
	FIELD_CHAR(0x0A),  /* system.apn */
	FIELD_CHAR(0x0B),  /* system.ntp_server */
	FIELD_CHAR(0x0C),  /* system.ntp_port */
	FIELD_CHAR(0x0D),  /* system.syslog_ip */
	FIELD_CHAR(0x0E),  /* system.syslog_port */
	FIELD_CHAR(0x0F),  /* system.can_bitrate */
	FIELD_CHAR(0x10),  /* buffer.storage_path */
	FIELD_CHAR(0x11),  /* buffer.max_batch_size */
);

/* -------------------------------------------------------------------------
 * Public API
 * ------------------------------------------------------------------------- */

int config_service_init(void)
{
	memcpy(status_value, "INIT", 4);
	status_len = 4;

	LOG_INF("Config service initialized (%d fields)", FIELD_COUNT);
	return 0;
}

void config_service_handle_response(uint8_t type, const uint8_t *payload,
				    uint32_t len)
{
	if (len > sizeof(rsp_buf.data)) {
		len = sizeof(rsp_buf.data);
	}

	rsp_buf.type = type;
	memcpy(rsp_buf.data, payload, len);
	rsp_buf.len = len;

	k_sem_give(&rsp_sem);
}
```

## src/config_service.h
```c
/*
 * config_service.h
 *
 * BLE GATT configuration service for RailNet200.
 *
 * Exposes iMX6 config file fields as individual GATT characteristics.
 * The NINA acts as a transparent relay — all JSON logic is on the iMX6.
 *
 * Each GATT read/write triggers a synchronous SOTP exchange with iMX6
 * (CONFIG_READ_REQ / CONFIG_WRITE / CONFIG_COMMIT).
 */

#ifndef CONFIG_SERVICE_H_
#define CONFIG_SERVICE_H_

#include <stdint.h>

/**
 * @brief Initialize the GATT config service.
 *
 * The GATT service is declared statically via BT_GATT_SERVICE_DEFINE,
 * so this function only initializes internal state (semaphores, buffers).
 *
 * Must be called from bt_ready_cb(), after bt_enable().
 *
 * @return 0 on success, negative error code on failure.
 */
int config_service_init(void);

/**
 * @brief Handle a CONFIG_*_RSP received from iMX6 via SOTP.
 *
 * Called by uart_relay.c::sotp_dispatch() when a response frame arrives.
 * Copies the payload into the shared response buffer and signals the
 * waiting GATT callback via semaphore.
 *
 * @param type     SOTP type (CONFIG_READ_RSP, CONFIG_WRITE_RSP, CONFIG_COMMIT_RSP)
 * @param payload  Response payload
 * @param len      Payload length
 */
void config_service_handle_response(uint8_t type, const uint8_t *payload,
				    uint32_t len);

#endif /* CONFIG_SERVICE_H_ */
```

## src/ots_handler.h
```c
/*
 * ots_handler.h
 *
 * Pool d'objets statique et callbacks OTS pour le firmware peripheral_ots_railnet.
 *
 * Interface publique utilisée par main.c :
 *   - ots_handler_init() : initialise le serveur OTS et le pool d'objets
 *   - ots_get_instance()  : retourne le pointeur bt_ots pour bt_ots_obj_add() etc.
 *   - ots_handler_add_object_from_uart() : ajoute un objet reçu de l'iMX6
 */

#ifndef OTS_HANDLER_H_
#define OTS_HANDLER_H_

#include <stdint.h>
#include <stddef.h>
#include <zephyr/bluetooth/services/ots.h>

/**
 * @brief Taille maximale d'un objet OTS en RAM (32 KB).
 *
 * Ajuster selon la RAM disponible après mesure avec west build --ram-report.
 * Contrainte nRF52840 : 256 KB totaux, ~100-150 KB disponibles après stack BLE.
 * Avec CONFIG_BT_OTS_MAX_OBJ_CNT=3 : 3 * 32KB = 96 KB.
 */
#define OTS_HANDLER_OBJ_MAX_SIZE  (32 * 1024)

/**
 * @brief Initialise le pool d'objets et enregistre le serveur OTS.
 *
 * Enregistre les callbacks OTS auprès de la stack Zephyr.
 * Doit être appelé depuis bt_ready_cb(), après bt_enable().
 *
 * @return 0 si succès, code d'erreur négatif sinon.
 */
int ots_handler_init(void);

/**
 * @brief Retourne l'instance OTS Zephyr.
 *
 * Utilisé par main.c si besoin d'appeler bt_ots_obj_add() manuellement.
 *
 * @return Pointeur vers struct bt_ots, ou NULL si non initialisé.
 */
struct bt_ots *ots_get_instance(void);

/**
 * @brief Callback appelé par uart_relay quand l'iMX6 envoie un objet vers BLE.
 *
 * Ajoute l'objet dans le pool OTS pour qu'un client BLE puisse le lire.
 *
 * @param data  Données de l'objet.
 * @param len   Longueur des données.
 * @param name  Nom de l'objet (chaîne NULL-terminée, max BT_OTS_OBJ_MAX_NAME_LEN).
 * @return 0 si succès, -ENOMEM si pool plein.
 */
int ots_handler_add_object_from_uart(const uint8_t *data, size_t len,
				     const char *name);

/**
 * @brief Remet le pool d'objets à zéro après une déconnexion BLE.
 *
 * Appelé depuis main.c::disconnected() pour libérer les slots qui
 * n'ont pas été explicitement supprimés via OACP Delete.
 * Permet à bt_le_adv_start() de réussir (évite ENOMEM).
 */
void ots_handler_cleanup_on_disconnect(void);

#endif /* OTS_HANDLER_H_ */
```

## src/uart_relay.h
```c
/*
 * uart_relay.h
 *
 * Protocole SOTP (STIMIO Object Transfer Protocol) sur UART entre
 * le NINA-B301 (nRF52840) et l'iMX6 Linux (/dev/ttymxc7).
 *
 * Format de trame :
 *   [0xAA][0x55][TYPE][LEN_LE_4B][PAYLOAD...][CRC16_LE_2B]
 *
 * CRC16 : CRC16-CCITT (poly 0x1021, init 0xFFFF) sur TYPE + LEN + PAYLOAD.
 *
 * Types de trames :
 *   0x01 OBJ_FROM_BLE : objet reçu de BLE → iMX6
 *   0x02 OBJ_TO_BLE   : objet à envoyer vers BLE ← iMX6
 *   0x03 ACK          : accusé de réception
 *   0x04 NACK         : erreur (1 octet payload = code erreur)
 *   0x05 STATUS       : statut périodique NINA
 *   0x06 FILE_REQUEST : demande de fichier BLE → iMX6
 */

#ifndef UART_RELAY_H_
#define UART_RELAY_H_

#include <stdint.h>
#include <stddef.h>

/** Types de trames SOTP */
#define SOTP_TYPE_OBJ_FROM_BLE  0x01
#define SOTP_TYPE_OBJ_TO_BLE    0x02
#define SOTP_TYPE_ACK           0x03
#define SOTP_TYPE_NACK          0x04
#define SOTP_TYPE_STATUS        0x05
#define SOTP_TYPE_FILE_REQUEST  0x06
#define SOTP_TYPE_DELETE_ACK    0x07

/** Configuration service SOTP types */
#define SOTP_TYPE_CONFIG_READ_REQ   0x10
#define SOTP_TYPE_CONFIG_READ_RSP   0x11
#define SOTP_TYPE_CONFIG_WRITE      0x12
#define SOTP_TYPE_CONFIG_WRITE_RSP  0x13
#define SOTP_TYPE_CONFIG_COMMIT     0x14
#define SOTP_TYPE_CONFIG_COMMIT_RSP 0x15

/** Codes d'erreur NACK */
#define SOTP_ERR_BUFFER_FULL    0x01
#define SOTP_ERR_TIMEOUT        0x02
#define SOTP_ERR_CRC            0x03
#define SOTP_ERR_NOT_FOUND      0x10
#define SOTP_ERR_IO             0x12
#define SOTP_ERR_INVALID        0x13

/**
 * @brief Initialise l'UART et le thread de réception SOTP.
 * @return 0 si succès, code d'erreur négatif sinon.
 */
int uart_relay_init(void);

/**
 * @brief Envoie un objet reçu de BLE vers l'iMX6 (trame OBJ_FROM_BLE).
 * @param data    Pointeur vers les données de l'objet.
 * @param len     Longueur des données en octets.
 * @return 0 si succès, code d'erreur négatif sinon.
 */
int uart_relay_send_object(const uint8_t *data, size_t len);

/**
 * @brief Envoie une requête de fichier vers l'iMX6 (trame FILE_REQUEST).
 *
 * Le sotp-bridge lit le fichier et le renvoie en OBJ_TO_BLE.
 *
 * @param path    Chemin du fichier (UTF-8, pas de null-terminator requis).
 * @param len     Longueur du chemin en octets.
 * @return 0 si succès, code d'erreur négatif sinon.
 */
int uart_relay_send_file_request(const uint8_t *path, size_t len);

/**
 * @brief Envoie un ACK SOTP pour signaler qu'un objet a été supprimé par le client BLE.
 *
 * Utilisé par le sotp-bridge pour synchroniser l'envoi de chunks
 * lors d'un FILE_REQUEST multi-chunk.
 */
void uart_relay_send_delete_ack(void);

/**
 * @brief Envoie CONFIG_READ_REQ vers l'iMX6.
 * @param file_id   Identifiant du fichier config (0x00 = /etc/stimio/config.json)
 * @param field_id  Identifiant du champ dans le fichier
 * @return 0 si succès, code d'erreur négatif sinon.
 */
int uart_relay_send_config_read(uint8_t file_id, uint8_t field_id);

/**
 * @brief Envoie CONFIG_WRITE vers l'iMX6.
 * @param file_id    Identifiant du fichier config
 * @param field_id   Identifiant du champ
 * @param value      Valeur UTF-8
 * @param value_len  Longueur de la valeur en octets
 * @return 0 si succès, code d'erreur négatif sinon.
 */
int uart_relay_send_config_write(uint8_t file_id, uint8_t field_id,
				 const void *value, uint16_t value_len);

/**
 * @brief Envoie CONFIG_COMMIT vers l'iMX6.
 * @param file_id  Identifiant du fichier config
 * @return 0 si succès, code d'erreur négatif sinon.
 */
int uart_relay_send_config_commit(uint8_t file_id);

#endif /* UART_RELAY_H_ */
```
